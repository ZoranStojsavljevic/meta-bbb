## conf/layer.conf
```bitbake
# We have a conf and classes directory, append to BBPATH
BBPATH .= ":${LAYERDIR}"

# We have a recipes directory, add to BBFILES
BBFILES += "${LAYERDIR}/recipes*/*/*.bb ${LAYERDIR}/recipes*/*/*.bbappend ${LAYERDIR}/images/*.bb"

# By default, PREFERRED_PROVIDER_virtual/kernel = "linux-stable"
# This line must be added here for "linux-torvalds" kernels
# PREFERRED_PROVIDER_virtual/kernel = "linux-torvalds"

BBFILE_COLLECTIONS += "meta-bbb"
BBFILE_PATTERN_meta-bbb := "^${LAYERDIR}/"
BBFILE_PRIORITY_meta-bbb = "16"

LAYERSERIES_COMPAT_meta-bbb = "scarthgap"
```
